## config/boards/shields/pinky4/Kconfig.defconfig
```kconfig
# Copyright (c) 2022 The ZMK Contributors
# SPDX-License-Identifier: MIT

if SHIELD_pinky4_DONGLE

config ZMK_KEYBOARD_NAME
    default "pinky4"

config ZMK_SPLIT_ROLE_CENTRAL
    default y

endif

if SHIELD_pinky4_LEFT || SHIELD_pinky4_DONGLE || SHIELD_pinky4_RIGHT

config ZMK_SPLIT
    default y

endif
```
